## build/Kconfig/Kconfig.sysbuild.modules
```kconfig
menu "nrf (C:/ncs/v2.6.1/nrf)"
osource "C:/ncs/v2.6.1/nrf/sysbuild/Kconfig.sysbuild"
config ZEPHYR_NRF_MODULE
	bool
	default y
endmenu
```

## build/Kconfig/boards/Kconfig.defconfig
```kconfig
# Load Zephyr board defconfig descriptions.
osource "C:/ncs/v2.8.0/zephyr/boards/nordic/nrf52840dk/Kconfig.defconfig"
```

## build/Nordic_Sensor_Notes/Kconfig/boards/Kconfig.nrf52840dk
```kconfig
# Load board Kconfig descriptions.
osource "C:/ncs/v2.8.0/zephyr/boards/nordic/nrf52840dk/Kconfig.nrf52840dk"
```

## build/Nordic_Sensor_Notes/Kconfig/boards/Kconfig.sysbuild
```kconfig
# Load Sysbuild board Kconfig descriptions.
osource "C:/ncs/v2.8.0/zephyr/boards/nordic/nrf52840dk/Kconfig.sysbuild"
```
